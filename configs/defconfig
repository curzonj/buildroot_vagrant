## configs/defconfig
```kconfig
BR2_PACKAGE_DROPBEAR=y
BR2_TARGET_ROOTFS_CPIO=y
BR2_TARGET_ROOTFS_CPIO_GZIP=y
BR2_LINUX_KERNEL=y
BR2_LINUX_KERNEL_CUSTOM_VERSION=y
BR2_LINUX_KERNEL_CUSTOM_VERSION_VALUE="3.9.11"
BR2_LINUX_KERNEL_DEFCONFIG="linux"
```

## templates/toolchain/configs/defconfig
```kconfig
BR2_x86_i686=y
BR2_ROOTFS_POST_BUILD_SCRIPT="/vagrant/templates/toolchain/root_fs_pre.sh"
BR2_LINUX_KERNEL_CUSTOM_VERSION=y
BR2_LINUX_KERNEL_CUSTOM_VERSION_VALUE="3.9.11"
```

## templates/vagrant/configs/defconfig
```kconfig
BR2_x86_i686=y
BR2_ROOTFS_DEVICE_CREATION_DYNAMIC_DEVTMPFS=y
BR2_TARGET_GENERIC_GETTY_PORT="console"
# BR2_TARGET_GENERIC_REMOUNT_ROOTFS_RW is not set
BR2_ROOTFS_OVERLAY="/vagrant/templates/vagrant/overlay"
BR2_ROOTFS_POST_BUILD_SCRIPT="/vagrant/templates/vagrant/root_fs_pre.sh"
BR2_ROOTFS_POST_IMAGE_SCRIPT="/vagrant/templates/vagrant/root_fs_post.sh"
BR2_PACKAGE_DROPBEAR=y
BR2_TARGET_ROOTFS_CPIO=y
BR2_TARGET_ROOTFS_CPIO_GZIP=y
BR2_LINUX_KERNEL=y
BR2_LINUX_KERNEL_CUSTOM_VERSION=y
BR2_LINUX_KERNEL_CUSTOM_VERSION_VALUE="3.9.11"
BR2_LINUX_KERNEL_DEFCONFIG="/vagrant/templates/vagrant/configs/linux.config"
```
